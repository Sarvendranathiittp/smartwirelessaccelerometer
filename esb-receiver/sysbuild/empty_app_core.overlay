/* empty_app_core Power-Optimized Overlay to Enable DCDC */
#include <zephyr/dt-bindings/regulator/nrf5x.h>

&vregmain {
    regulator-initial-mode = <NRF5X_REG_MODE_DCDC>;
};

&vregradio {
    regulator-initial-mode = <NRF5X_REG_MODE_DCDC>;
};

&vregh {
    status = "okay";
};
