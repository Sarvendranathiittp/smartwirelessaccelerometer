## esp32-receiver-dac7578/sdkconfig.defaults
```kconfig
# ============================================
# ISRO BLE Receiver - ESP32-S3-Zero
# sdkconfig defaults
# ============================================

# --- Bluetooth ---
CONFIG_BT_ENABLED=y
CONFIG_BT_NIMBLE_ENABLED=y
CONFIG_BT_NIMBLE_ROLE_CENTRAL=y
CONFIG_BT_NIMBLE_ROLE_PERIPHERAL=n
CONFIG_BT_NIMBLE_ROLE_OBSERVER=y
CONFIG_BT_NIMBLE_ROLE_BROADCASTER=n
CONFIG_BT_NIMBLE_MAX_CONNECTIONS=1

# BLE 5.0 features (2M PHY, DLE)
CONFIG_BT_NIMBLE_50_FEATURE_SUPPORT=y
CONFIG_BT_NIMBLE_LE_PHY_2M=y
CONFIG_BT_NIMBLE_EXT_ADV=n

# NimBLE ATT/GATT
CONFIG_BT_NIMBLE_ATT_PREFERRED_MTU=256

# --- Console via USB Serial/JTAG ---
CONFIG_ESP_CONSOLE_USB_SERIAL_JTAG=y

# --- Performance ---
CONFIG_ESP_DEFAULT_CPU_FREQ_MHZ_240=y
CONFIG_FREERTOS_HZ=1000

# --- Logging ---
CONFIG_LOG_DEFAULT_LEVEL_INFO=y

# --- Flash ---
CONFIG_ESPTOOLPY_FLASHSIZE_4MB=y
CONFIG_BT_NIMBLE_HOST_BASED_PRIVACY=n
CONFIG_BT_NIMBLE_EXT_ADV=n
CONFIG_BT_NIMBLE_MAX_CONNECTIONS=1
CONFIG_BT_NIMBLE_TRANSPORT_ACL_SIZE=255
CONFIG_BT_NIMBLE_MSYS1_BLOCK_COUNT=24
CONFIG_BT_NIMBLE_MSYS_1_BLOCK_SIZE=256
CONFIG_BT_NIMBLE_ATT_PREFERRED_MTU=256
CONFIG_BT_NIMBLE_EXT_ADV=n
CONFIG_BT_NIMBLE_HOST_BASED_PRIVACY=n
CONFIG_BT_NIMBLE_MAX_CONNECTIONS=1
CONFIG_BT_NIMBLE_ATT_PREFERRED_MTU=256
CONFIG_BT_NIMBLE_MSYS_1_BLOCK_COUNT=24
CONFIG_BT_NIMBLE_MSYS_1_BLOCK_SIZE=256
CONFIG_BT_NIMBLE_TRANSPORT_ACL_SIZE=255
```

## esp32-transmitter/sdkconfig.defaults
```kconfig
# ============================================
# ISRO BLE Transmitter - ESP32-S3-Zero
# sdkconfig defaults
# ============================================

# --- Bluetooth ---
CONFIG_BT_ENABLED=y
CONFIG_BT_NIMBLE_ENABLED=y
CONFIG_BT_NIMBLE_ROLE_CENTRAL=n
CONFIG_BT_NIMBLE_ROLE_PERIPHERAL=y
CONFIG_BT_NIMBLE_ROLE_OBSERVER=n
CONFIG_BT_NIMBLE_ROLE_BROADCASTER=y
CONFIG_BT_NIMBLE_MAX_CONNECTIONS=1

# BLE 5.0 features (2M PHY, DLE)
CONFIG_BT_NIMBLE_50_FEATURE_SUPPORT=y
CONFIG_BT_NIMBLE_LE_PHY_2M=y

# NimBLE ATT/GATT
CONFIG_BT_NIMBLE_ATT_PREFERRED_MTU=256

# --- Console via USB Serial/JTAG ---
CONFIG_ESP_CONSOLE_USB_SERIAL_JTAG=y

# --- Performance ---
CONFIG_ESP_DEFAULT_CPU_FREQ_MHZ_240=y
CONFIG_FREERTOS_HZ=1000

# --- Logging ---
CONFIG_LOG_DEFAULT_LEVEL_INFO=y

# --- Flash ---
CONFIG_ESPTOOLPY_FLASHSIZE_4MB=y
CONFIG_BT_NIMBLE_TRANSPORT_ACL_SIZE=255
CONFIG_BT_NIMBLE_MSYS_1_BLOCK_COUNT=24
CONFIG_BT_NIMBLE_MSYS_1_BLOCK_SIZE=256
```
